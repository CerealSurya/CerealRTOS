/**
 *
 * @cliArgs --board "/ti/boards/LP_MSPM0G3507" --product "mspm0_sdk@2.05.00.05"
 * @versions {"tool":"1.28.1+4785"}
 */

/**
 * Import the modules used in this configuration.
 */
const GPIO          = scripting.addModule("/ti/driverlib/GPIO", {}, false);
const GPIO1         = GPIO.addInstance();
const ProjectConfig = scripting.addModule("/ti/project_config/ProjectConfig");

/**
 * Write custom configuration values to the imported modules.
 */
GPIO1.$name                                 = "GPIO_GRP_0";
GPIO1.associatedPins[0].$name               = "PIN_0";
GPIO1.associatedPins[0].assignedPortSegment = "Lower";
GPIO1.associatedPins[0].assignedPin         = "0";

const Board = scripting.addModule("/ti/driverlib/Board", {}, false);

const SYSCTL = scripting.addModule("/ti/driverlib/SYSCTL", {}, false);

/**
 * Pinmux solution for unlocked pins/peripherals. This ensures that minor changes to the automatic solver in a future
 * version of the tool will not impact the pinmux you originally saw.  These lines can be completely deleted in order to
 * re-solve from scratch.
 */
GPIO1.associatedPins[0].pin.$suggestSolution = "boosterpack.12";
Board.peripheral.$suggestSolution            = "DEBUGSS";
Board.peripheral.swclkPin.$suggestSolution   = "j25_expansion.16";
Board.peripheral.swdioPin.$suggestSolution   = "j25_expansion.14";
SYSCTL.peripheral.$suggestSolution           = "SYSCTL";
